## zmk_keyboards/zmk-config/boards/shields/riball/Kconfig.shield
```kconfig
# Copyright (c) 2020 Pete Johanson
# SPDX-License-Identifier: MIT

config SHIELD_RIBALL_LEFT
    def_bool $(shields_list_contains,riball_left)

config SHIELD_RIBALL_RIGHT
    def_bool $(shields_list_contains,riball_right)
```

## zmk_keyboards/zmk-config/boards/shields/ritemper/Kconfig.defconfig
```kconfig
if SHIELD_RITEMPER_LEFT
config ZMK_KEYBOARD_NAME
    default "ritemper"

config ZMK_SPLIT_ROLE_CENTRAL
    default y

endif

if SHIELD_RITEMPER_LEFT || SHIELD_RITEMPER_RIGHT

config ZMK_SPLIT
    default y

config ZMK_SLEEP
    default y

endif
```

## zmk_keyboards/zmk-config/boards/shields/ritemper/Kconfig.shield
```kconfig
# Copyright (c) 2020 Pete Johanson
# SPDX-License-Identifier: MIT

config SHIELD_RITEMPER_LEFT
    def_bool $(shields_list_contains,ritemper_left)

config SHIELD_RITEMPER_RIGHT
    def_bool $(shields_list_contains,ritemper_right)
```
